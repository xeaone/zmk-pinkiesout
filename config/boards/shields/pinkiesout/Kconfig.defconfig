## config/boards/shields/pinkiesout/Kconfig.defconfig
```kconfig
# Copyright (c) 2021 The ZMK Contributors
# SPDX-License-Identifier: MIT


if SHIELD_PINKIESOUT

config ZMK_KEYBOARD_NAME
    default "pinkiesout"

endif
```

## config/boards/shields/pinkiesout/Kconfig.shield
```kconfig
# Copyright (c) 2021 The ZMK Contributors
# SPDX-License-Identifier: MIT

config SHIELD_PINKIESOUT
    def_bool $(shields_list_contains,pinkiesout)
```
